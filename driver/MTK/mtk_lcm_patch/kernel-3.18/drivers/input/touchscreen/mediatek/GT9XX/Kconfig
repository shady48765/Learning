## driver/MTK/mtk_lcm_patch/kernel-3.18/drivers/input/touchscreen/mediatek/GT9XX/Kconfig
```kconfig
#
# Touchscreen driver configuration
#
if TOUCHSCREEN_GT9XX

endif

config TP_PROXIMITY_SUPPORT
	bool "GT9XX for TPD_PROXIMITY_SUPPORT"
	default n
	help
	  Say Y here if you have GT9XX TPD_PROXIMITY.

	  If unsure, say N.

	  To compile this dirver as a module, choose M here: the
	  module will be called.
```

## driver/MTK/touch_panel/GT9721/mtk_file/touchscreen/GSLX688/Kconfig
```kconfig
#
# Touchscreen driver configuration
#
if TOUCHSCREEN_MTK_GSLX688

endif

config TP_PROXIMITY_SUPPORT
	bool "GSLX688 for TPD_PROXIMITY_SUPPORT"
	default n
	help
	  Say Y here if you have GSLX688 TPD_PROXIMITY.

	  If unsure, say N.

	  To compile this dirver as a module, choose M here: the
	  module will be called.
```
