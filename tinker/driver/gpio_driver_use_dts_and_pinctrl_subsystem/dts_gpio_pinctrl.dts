	// file : rk3288-miniarm.dts
    laser {
		compatible = "laser";
		label = "laser prot";

		laser-on = <&gpio5 RK_PC3 GPIO_ACTIVE_HIGH>;        // ---> RK_PC3 defined in <dt-bindings/pinctrl/rockchip.h>
		laser-off = <&gpio5 RK_PC3 GPIO_ACTIVE_LOW>;
		// 		laser-on = <GPIO5_C3 GPIO_ACTIVE_LOW>;		---> need #include <dt-bindings/pinctrl/rockchip-rk3288.h>
		// 		laser-on = <GPIO5_C3 GPIO_ACTIVE_LOW>;		---> need #include <dt-bindings/pinctrl/rockchip-rk3288.h>
		status = "okay";
	};
