// file : rk3288-miniarm.dts

laser {
	compatible = "laser-pinctrl";
	label = "laser-pinctrl";

	pinctrl-name = "default", "laser_output_high","laser_output_low","laser_pin_input";
	pinctrl-0 = <&laser_pin_default>;
    pinctrl-1 = <&laser_pin_output_high>;
    pinctrl-2 = <&laser_pin_output_low>;
    pinctrl-3 = <&laser_pin_input>;
	status = "okay";
};
&pinctrl {

    laser_pin_default: laser_pin_default {
        rockchip,pins = <RK_GPIO5 RK_PC3 RK_FUNC_GPIO, &pcfg_pull_up>;
	};
    laser_pin_output_high: laser_pin_output_high {
        rockchip,pins = <RK_GPIO5 RK_PC3 RK_FUNC_GPIO, &pcfg_pull_up>;
	};
    laser_pin_output_low: laser_pin_output_low {
        rockchip,pins = <RK_GPIO5 RK_PC3 RK_FUNC_GPIO, &pcfg_pull_down>;
	};
    laser_pin_input: laser_pin_input {
        rockchip,pins = <RK_GPIO5 RK_PC3 RK_FUNC_GPIO, &pcfg_pull_none>;
	};

        ......
    }
